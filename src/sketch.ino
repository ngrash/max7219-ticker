#include "LedControl.h"
#include <avr/pgmspace.h>

#define PADDING             9
#define MSG_BUFFER_LENGTH 256
#define FRAME_DELAY        50

#define BAUD_RATE      9600
#define SERIAL_TIMEOUT 1000

#define DATA_PIN    12
#define CLOCK_PIN   11
#define SELECT_PIN  10
#define NUM_DEVICES  1

const byte font[][6] PROGMEM = {
  {1, 0x00},                         // (space)
  {1, 0xfa},                         // !
  {3, 0xe0, 0x00, 0xe0},             // "
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  {3, 0x82, 0x6c, 0x10},             // }
};

LedControl lc = LedControl(DATA_PIN, CLOCK_PIN, SELECT_PIN, NUM_DEVICES);
byte* columnsBuffer;
int columnsBufferSize;
char messageBuffer[MSG_BUFFER_LENGTH];

void setup() {
  lc.shutdown(0, false);
  lc.setIntensity(0, 1);
  lc.clearDisplay(0);

  Serial.begin(BAUD_RATE);
  Serial.setTimeout(SERIAL_TIMEOUT);

  buildColumnsBuffer("works for me");
}

void loop() {
  brotocol();
  drawFrames(columnsBuffer, columnsBufferSize);
}

void brotocol() {
  if(Serial.available() > 0) {
    char hello[3];
    byte bytesRead = Serial.readBytes(hello, 2);
    hello[2] = '\0';

    if(strcmp(hello, "hi") == 0) {
      Serial.println("sup?");
      buildColumnsBuffer("...");
      while(!Serial.available()) { drawFrames(columnsBuffer, columnsBufferSize); }

      readMsg(messageBuffer, MSG_BUFFER_LENGTH);
      buildColumnsBuffer(messageBuffer);
    }
  }
}

void readMsg(char* buffer, int length) {
  byte bytesRead = Serial.readBytesUntil('\0', buffer, length-1);
  buffer[bytesRead] = '\0';
}

void buildColumnsBuffer(char* msg) {
  destroyColumnsBuffer();

  columnsBufferSize = calculateColumnCount(msg) + PADDING*2;
  columnsBuffer = (byte*)malloc(columnsBufferSize);
  fillColumnsBuffer(msg, columnsBuffer);
}

void destroyColumnsBuffer() {
  if(columnsBuffer == 0) {
    free(columnsBuffer);
    columnsBuffer = 0;
    columnsBufferSize = 0;
  }
}

int calculateColumnCount(const char* msg) {
  int count = 0;
  char ch;
  for(int i = 0; (ch = msg[i]) != 0; i++) {
    int index = getCharIndex(ch);
    count += getCharColumnCount(index);
    count += 1; // one blank col after each char
  }

  return count;
}

void fillColumnsBuffer(char* message, byte* buffer) {
  for(int i = 0; i < PADDING; i++) {
    buffer[i] = 0;
  }

  int totalColumnIdx = PADDING;
  while(*message) {
    char ch = *message++;
    int index = getCharIndex(ch);
    int columnCount = getCharColumnCount(index);

    for(int columnIdx = 0; columnIdx < columnCount; columnIdx++) {
      buffer[totalColumnIdx++] = getCharColumnData(index, columnIdx);
    }

    buffer[totalColumnIdx++] = '\0';
  }

  for(int i = 0; i < PADDING; i++) {
    buffer[totalColumnIdx+i] = 0;
  }
}

int getCharIndex(char ch) {
  return (int)(ch - 32);
}

int getCharColumnCount(int position) {
  return pgm_read_byte(&(font[position][0]));
}

byte getCharColumnData(int position, int columnIdx) {
  return pgm_read_byte(&(font[position][1+columnIdx]));
}

void drawFrames(byte* buffer, int bufferSize) {
  for(int i = 0; i < bufferSize-8; i++) {
    drawFrame(i, buffer, bufferSize);
    delay(FRAME_DELAY);
  }
}

void drawFrame(int frame, byte* buffer, int bufferSize) {
  for(int i = 0; i < 8; i++) {
    byte col = buffer[frame + i];
    lc.setColumn(0, i, col);
  }
}
